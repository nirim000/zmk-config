## boards/shields/pzow/Kconfig.defconfig
```kconfig
if SHIELD_PZOW_LEFT

config ZMK_KEYBOARD_NAME
    default "pzow"

config ZMK_SPLIT_ROLE_CENTRAL
    default y

endif # SHIELD_PZOW_LEFT

if SHIELD_PZOW_LEFT || SHIELD_PZOW_RIGHT

config ZMK_SPLIT
    default y

endif # SHIELD_PZOW_LEFT || SHIELD_PZOW_RIGHT
```

## boards/shields/pzow/Kconfig.shield
```kconfig
config SHIELD_PZOW_LEFT
    def_bool $(shields_list_contains,pzow_left)

config SHIELD_PZOW_RIGHT
    def_bool $(shields_list_contains,pzow_right)
```

## boards/shields/pzow2/Kconfig.defconfig
```kconfig
if SHIELD_PZOW2_LEFT

config ZMK_KEYBOARD_NAME
    default "pzow2"

config ZMK_SPLIT_ROLE_CENTRAL
    default y

endif # SHIELD_PZOW2_LEFT

if SHIELD_PZOW2_LEFT || SHIELD_PZOW2_RIGHT

config ZMK_SPLIT
    default y

endif # SHIELD_PZOW2_LEFT || SHIELD_PZOW2_RIGHT
```

## boards/shields/pzow2/Kconfig.shield
```kconfig
config SHIELD_PZOW2_LEFT
    def_bool $(shields_list_contains,pzow2_left)

config SHIELD_PZOW2_RIGHT
    def_bool $(shields_list_contains,pzow2_right)
```
